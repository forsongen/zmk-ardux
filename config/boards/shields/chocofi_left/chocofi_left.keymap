/*
 * Copyright (c) 2021 Mike "KemoNine" Crosson
 *
 * SPDX-License-Identifier: MIT
 */

#include <behaviors.dtsi>
#include <dt-bindings/zmk/keys.h>
#include <dt-bindings/zmk/bt.h>

// Enable LEFT BIG HALFMAK
#define ARDUX_LEFT 1
#define ARDUX_BIG 1
#define ARDUX_HALFMAK 1

// ARTS Row
#define KEY_A 3
#define KEY_R 2
#define KEY_T 1
#define KEY_S 0
// EYIO Row
#define KEY_E 8
#define KEY_Y 7
#define KEY_I 6
#define KEY_O 5
// Big ardux F1-12 layer keys for combo
#define KEY_F_TOP 4
#define KEY_F_BOTTOM 9

// Define Offsets
#define LEADING_NONES NONE(0, 0, 0)
#define MIDDLE_NONES NONE(0, 0, 1)
#define TRAILING_NONES NONE(0, 0, 9)
#define BIG_LEADING_NONES NONE(0, 0, 0)
#define BIG_BETWEEN_ROW_ONE_TWO_NONES NONE(0, 0, 0)
#define BIG_BETWEEN_ROW_TWO_THREE_NONES NONE(0, 0, 0)
#define BIG_BETWEEN_ROW_THREE_THUMBS NONE(0, 0, 0)
#define BIG_TRAILING_NONES NONE(0, 0, 0)

// Define custom layer
#define ARDUX_LAYER_CUSTOM                                                     \
		custom {                                                               \
			label = "Custom";                                                  \
			bindings = <                                                       \
				LEADING_NONES                                                  \
				&none                 &kp LG(C)     &kp LG(V)     &kp C_PP     \
				MIDDLE_NONES                                                   \
				&tog LAYER_ID_CUSTOM  &kp C_MUTE    &kp C_VOL_DN  &kp C_VOL_UP \
				TRAILING_NONES                                                 \
			>;                                                                 \
		};
#endif

// Include main ardux.io keymap
#include "../../../ardux.dtsi"
