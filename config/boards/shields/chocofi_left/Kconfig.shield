## config/boards/shields/chocofi_left/Kconfig.shield
```kconfig
# Copyright (c) 2021 Mike "KemoNine" Crosson
# SPDX-License-Identifier: MIT

config SHIELD_CHOCOFI_ARDUX_LEFT
    def_bool $(shields_list_contains,chocofi_ardux_left)
```
